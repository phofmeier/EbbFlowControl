## components/configuration/Kconfig
```kconfig
menu "Configuration Application Config"
    config MAX_NUMBER_PUMP_CYCLES_PER_DAY
        int "Maximum number of pump cycles per day."
        default 24
        help
            Set the maximum number of pump cycles per day.

endmenu
```

## components/driver_gp8211s/Kconfig
```kconfig
menu "GP8211S I2C Configuration"
    config GP8211S_I2C_SCL_PIN
        int "GP8211S I2C SCL pin"
        default 22
        help
            Set the GPIO pin number used for the GP8211S I2C SCL line.

    config GP8211S_I2C_SDA_PIN
        int "GP8211S I2C SDA pin"
        default 21
        help
            Set the GPIO pin number used for the GP8211S I2C SDA line.
endmenu
```

## components/driver_hc_sr04/Kconfig
```kconfig
menu "HC-SR04 Driver"
    config HC_SR04_TRIGGER_PIN
        int "GPIO Pin for HC-SR04 Trigger"
        default 5
        help
            Set the GPIO pin number used to trigger the HC-SR04 sensor.

    config HC_SR04_ECHO_PIN
        int "GPIO Pin for HC-SR04 Echo"
        default 18
        help
            Set the GPIO pin number used to receive the echo signal from the HC-SR04 sensor.
endmenu
```

## components/level_sensor/Kconfig
```kconfig
menu "Level Sensor Application Config"
    config MQTT_LEVEL_STATUS_TOPIC
        string "MQTT Topic for the Level Sensor Status"
        default "ef/efc/timed/level"
        help
            Set the MQTT topic to publish the level sensor distance in millimeters.

    config LEVEL_SENSOR_UPDATE_INTERVAL
        int "Level Sensor Update Interval (min)"
        default 60
        help
            Set the interval in minutes for how often the level sensor data should be published.
endmenu
```

## components/light_control/Kconfig
```kconfig
menu "Light Application Config"
    config MQTT_LIGHT_STATUS_TOPIC
    string "MQTT Topic for the Light Status"
    default "ef/efc/timed/light"
    help
        Set the MQTT topic to publish the pump status
endmenu
```

## components/mqtt5_connection/Kconfig
```kconfig
menu "MQTT Application Configuration"
    config MQTT_USERNAME
        string "Username for MQTT."
        default ""
        help
            Set the username to connect to the MQTT broker.

    config MQTT_PASSWORD
        string "Password for MQTT."
        default ""
        help
            Set the password to connect to the MQTT broker.

    config MQTT_TIMEOUT_RECONNECT_MS
        int "Time to wait between reconnect attempts in ms."
        default 30000
        help
            Set the time to wait between reconnect attempts to the MQTT broker. (Default 30 s)

    config MQTT_STATUS_TOPIC
        string "TOPIC for the status channel."
        default "ef/efc/static/status"
        help
            Set the topic which publishes the current status.

    config MQTT_CONFIG_RECEIVE_TOPIC
        string "Topic for receiving configs."
        default "ef/efc/config/set"
        help
            Set the topic where new configurations are arrived.

    config MQTT_CONFIG_SEND_TOPIC
        string "Topic for sending configs."
        default "ef/efc/static/config"
        help
            Set the topic on which the current config is published.

endmenu
```

## components/ota_updater/Kconfig
```kconfig
menu "OTA Updater Configuration"
    config OTA_FIRMWARE_UPGRADE_URL
        string "URL for firmware upgrade."
        default "https://github.com/phofmeier/EbbFlowControl/releases/latest/download/EbbFlowControl.bin"
        help
            Set the URL from which to download the firmware upgrade.
    config OTA_USE_CERT_BUNDLE
        bool "Use certificate bundle for HTTPS."
        depends on MBEDTLS_CERTIFICATE_BUNDLE
        default y
        help
            Enable this option to use the built-in certificate bundle for HTTPS connections. If disabled, a custom server certificate must be provided.
endmenu
```

## components/pump_control/Kconfig
```kconfig
menu "Pump Application Config"
    config PUMP_GPIO_OUTPUT_PIN
        int "GPIO Pin of the Pump"
        default 4
        help
            Set the pin number to activate the pump

    config MQTT_PUMP_STATUS_TOPIC
        string "MQTT Topic for the Pump Status"
        default "ef/efc/timed/pump"
        help
            Set the MQTT topic to publish the pump status

    config LOCAL_TIME_ZONE
        string "Local time zone"
        default "CET-1CEST,M3.5.0,M10.5.0/3"
        help
            Code for the local time zone which is used to setup the pumping times. (Defaults to Germany/Berlin)

endmenu
```

## components/wifi_utils/Kconfig
```kconfig
menu "Wifi Application Config"
    config WIFI_MAXIMUM_RETRY
        int "Maximum attempts of WIFI connection retries."
        default 2
        help
            Set the maximum number of attempts to try to connect to the wifi. (Set to -1 for infinite attempts.)

    config WIFI_WAIT_TIME_BETWEEN_RETRY_MS
        int "Time to wait between WIFI connection retries in ms."
        default 600000
        help
            Set the time to wait between retries to connect to the wifi. (Default 10 min)

    config WIFI_SNTP_POOL_SERVER
        string "URL to the SNTP server."
        default "pool.ntp.org"
        help
            Server Address of the SNTP server pool to synchronize the system time.

    config WIFI_SNTP_INIT_WAIT_TIME_MS
        int "Time to wait for the initial SNTP server response in ms."
        default 60000
        help
            Set the time to wait for the initial SNTP server response. (Default 1 min)


endmenu
```

## main/Kconfig.projbuild
```kconfig
menu "Application Configuration"
    config WIFI_SSID
        string "SSID of the used Wifi."
        default "wifi_ssid"
        help
            Add the name of the Wifi Network.

    config WIFI_PASSWORD
        string "Password of the used Wifi."
        default "wifi_password"
        help
            Add the password of the Wifi Network.

    config DEVICE_ID
        int "Device ID (0-255)."
        default 0
        help
            Device ID of this specific device. Needs to be change if more than one device is used.

    config MQTT_BROKER_URI
        string "URI of the MQTT broker."
        default "mqtt.uri.example"
        help
            Set the URI to the MQTT broker.

    config BUILD_FACTORY
        bool "Build factory firmware"
        default n
        help
            If enabled, the factory firmware will be built instead of the normal application.
            This is useful for initial setup or testing purposes.


endmenu
```
